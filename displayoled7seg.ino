#include <Arduino.h>
#include <Wire.h>
#include <SPI.h>
#include <MultiLCD.h>
#include "nRF24L01.h"
#include "RF24.h"


RF24 radio(9,10);
// Radio pipe addresses for the 2 nodes to communicate.
const uint64_t pipes[2] = { 0xF0F0F0F0E1LL, 0xF0F0F0F0D3LL };

enum { RMSG_JOYXY = 1, MRSG_SIMPLEPROX = 2, RMSG_INFO = 3  } RADIOMSGTYPES;
struct radiomsg {
  int type;
  union {
    struct {
      int h;
      int v;
    } joyxy;
    struct {
      int distancecm;
      int angle;
    } prox;    
    struct {
      char buf[20];
    } info;
    int dummy;
  };
};



LCD_SSD1306 lcd;




static const PROGMEM uint8_t smile[48 * 48 / 8] = {
0x00,0x00,0x00,0x00,0x00,0x00,0x80,0xC0,0xE0,0xF0,0xF8,0xF8,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0x00,
0x00,0xC0,0xF0,0xFC,0xFE,0xFF,0xFF,0xFF,0x3F,0x1F,0x0F,0x07,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0x00,
0xFE,0xFF,0xFF,0xFF,0xFF,0xFF,0x07,0x00,0x00,0x00,0x00,0x00,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0xFE,
0x7F,0xFF,0xFF,0xFF,0xFF,0xFF,0xE0,0x00,0x00,0x30,0xF8,0xF8,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0x7F,
0x00,0x03,0x0F,0x3F,0x7F,0xFF,0xFF,0xFF,0xFC,0xF8,0xF0,0xE1,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0x00,
0x00,0x00,0x00,0x00,0x00,0x00,0x01,0x03,0x07,0x0F,0x1F,0x1F,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0x00,
};

int joyv = 512;
int joyh = 512;
int distancecm = 0, angle = 0;
char info[40];

void setup()
{
      Serial.begin(57600);

   	lcd.begin();
        lcd.draw(smile, 40, 8, 48, 48);
	delay(1000);

    radio.begin();
    radio.setRetries(15,15);
       
    radio.openWritingPipe(pipes[1]);
    radio.openReadingPipe(1,pipes[0]);
      
    radio.startListening();
    radio.printDetails();
  
lcd.clear();
     strcpy(info,"");
}


void loop()
{
//	lcd.clear();
//	lcd.draw(smile, 40, 8, 48, 48);
//	delay(1000);



    // if there is data ready
    if ( radio.available() )
    {
//        Serial << "packet!!!!..." << endl;
  
        // Dump the payloads until we've gotten everything
        unsigned long got_time;
        bool done = false;
        while (!done)
        {
            struct radiomsg msg;
            msg.type = 0;
            // Fetch the payload, and see if this was the last one.
            done = radio.read( &msg, sizeof(radiomsg) );

//            printf("Got payload done:%d %d  h:%d v:%d...\n\r", done, msg.type, msg.joyxy.h, msg.joyxy.v );
            if( done ) 
            {
              switch( msg.type ) 
              {
                 case MRSG_SIMPLEPROX:
                     distancecm = msg.prox.distancecm;
                     angle = msg.prox.angle;
                    break;       
                 case RMSG_JOYXY:              
                    joyh = msg.joyxy.h;
                    joyv = msg.joyxy.v;  
                    break;   
                 case RMSG_INFO:
                    strcpy(info,msg.info.buf);
                    break;   

            } 

            }
        }
    }

	//lcd.clear();

        char buf[100];
        sprintf(buf,"h:%4d v:%4d", joyh, joyv);
        lcd.setCursor(0, 0);
	lcd.setFont(FONT_SIZE_SMALL);
	lcd.print(buf);

        sprintf(buf,"angle:%4d cm:%4d", angle, distancecm);
        lcd.setCursor(0, 1);
	lcd.setFont(FONT_SIZE_SMALL);
	lcd.print(buf);

        sprintf(buf,"%s", info);
        lcd.setCursor(0, 2);
	lcd.setFont(FONT_SIZE_SMALL);
	lcd.print(buf);


	lcd.setCursor(0, 5);
	lcd.setFont(FONT_SIZE_LARGE);
	lcd.printLong(12345671);

            // Delay just a little bit to let the other unit
            // make the transition to receiver
            delay(20);
//	delay(1000);
}
